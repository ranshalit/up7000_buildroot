## br2-external/Config.in
```kconfig
source "$BR2_EXTERNAL_UP7000_EXTRAS_PATH/package/openvino-runtime/Config.in"
source "$BR2_EXTERNAL_UP7000_EXTRAS_PATH/package/intel-compute-runtime/Config.in"
source "$BR2_EXTERNAL_UP7000_EXTRAS_PATH/package/intel-ipp/Config.in"
source "$BR2_EXTERNAL_UP7000_EXTRAS_PATH/package/openvino-demo/Config.in"
```

## br2-external/package/intel-compute-runtime/Config.in
```kconfig
config BR2_PACKAGE_INTEL_COMPUTE_RUNTIME
	bool "intel-compute-runtime"
	depends on BR2_x86_64
	depends on BR2_TOOLCHAIN_USES_GLIBC
	select BR2_PACKAGE_INTEL_GMMLIB
	help
	  Intel Compute Runtime (NEO) — the OpenCL ICD and Level Zero GPU
	  driver for Intel integrated and discrete graphics.

	  Required for OpenVINO GPU inference plugin to offload inference
	  to the Intel iGPU (e.g. Alder Lake-N on the UP7000).

	  Installs pre-built x86_64 binaries from Intel's GitHub releases,
	  including the OpenCL ICD (libigdrcl.so), Level Zero GPU driver,
	  and Intel Graphics Compiler (IGC) runtime libs.

	  https://github.com/intel/compute-runtime

comment "intel-compute-runtime requires a glibc toolchain and x86_64"
	depends on BR2_x86_64
	depends on !BR2_TOOLCHAIN_USES_GLIBC
```

## br2-external/package/intel-ipp/Config.in
```kconfig
config BR2_PACKAGE_INTEL_IPP
	bool "intel-ipp"
	depends on BR2_x86_64
	depends on BR2_TOOLCHAIN_USES_GLIBC
	help
	  Intel Integrated Performance Primitives (IPP) — a multi-threaded
	  library of signal processing, image processing, data compression,
	  and math functions optimised for Intel CPUs.

	  Installs the pre-built x86_64 runtime shared libraries to the
	  target and, for the SDK, also installs headers, CMake config
	  (IPPConfig.cmake), and static libraries to staging.

	  https://www.intel.com/content/www/us/en/developer/tools/oneapi/ipp.html

comment "intel-ipp requires a glibc toolchain and x86_64"
	depends on BR2_x86_64
	depends on !BR2_TOOLCHAIN_USES_GLIBC
```

## br2-external/package/openvino-benchmark/Config.in
```kconfig
config BR2_PACKAGE_OPENVINO_BENCHMARK
	bool "openvino-benchmark"
	depends on BR2_x86_64
	depends on BR2_TOOLCHAIN_USES_GLIBC
	depends on BR2_INSTALL_LIBSTDCPP
	select BR2_PACKAGE_OPENVINO_RUNTIME
	help
	  Inference benchmark tool for the OpenVINO 2024 C++ API.

	  Measures throughput (FPS) and latency statistics
	  (avg/min/max/p50/p90/p99) for any OpenVINO-compatible model
	  (.xml IR or .onnx) on the specified device.

	  Installs:
	    /usr/bin/benchmark_app

	  Usage:
	    benchmark_app -m <model.xml> [-d CPU|GPU|NPU|AUTO] \
	                  [-niter 1000] [-nwarmup 5] [-nireq 1] [-async]

	  https://github.com/openvinotoolkit/openvino

comment "openvino-benchmark requires a glibc toolchain, x86_64, and C++ support"
	depends on !BR2_x86_64 || !BR2_TOOLCHAIN_USES_GLIBC || !BR2_INSTALL_LIBSTDCPP
```

## br2-external/package/openvino-demo/Config.in
```kconfig
config BR2_PACKAGE_OPENVINO_DEMO
	bool "openvino-demo"
	depends on BR2_x86_64
	depends on BR2_TOOLCHAIN_USES_GLIBC
	depends on BR2_INSTALL_LIBSTDCPP
	select BR2_PACKAGE_OPENVINO_RUNTIME
	select BR2_PACKAGE_OPENCV4
	select BR2_PACKAGE_OPENCV4_LIB_IMGPROC
	select BR2_PACKAGE_OPENCV4_LIB_IMGCODECS
	select BR2_PACKAGE_OPENCV4_WITH_JPEG
	select BR2_PACKAGE_OPENCV4_WITH_PNG
	help
	  Object-detection demo using OpenVINO C++ API and YOLOv8n (ONNX).

	  Installs:
	    /usr/bin/openvino-detect          - demo binary
	    /usr/share/openvino-demo/models/  - YOLOv8n ONNX model
	    /usr/share/openvino-demo/images/  - sample JPEG images

	  Usage:
	    openvino-detect [--device CPU|GPU] [image1.jpg ...]
	  Output annotated images are written to /tmp/ov-demo-out/.

comment "openvino-demo requires a glibc toolchain, x86_64, and C++ support"
	depends on !BR2_x86_64 || !BR2_TOOLCHAIN_USES_GLIBC || !BR2_INSTALL_LIBSTDCPP
```

## br2-external/package/openvino-runtime/Config.in
```kconfig
config BR2_PACKAGE_OPENVINO_RUNTIME
	bool "openvino-runtime"
	depends on BR2_x86_64
	depends on BR2_TOOLCHAIN_USES_GLIBC
	select BR2_PACKAGE_TBB
	help
	  Intel OpenVINO Toolkit runtime libraries (CPU + GPU inference
	  plugins, ONNX/IR/PaddlePaddle frontends).

	  This installs the pre-built x86_64 Linux runtime from Intel's
	  official release archive.

	  https://github.com/openvinotoolkit/openvino

comment "openvino-runtime requires a glibc toolchain and x86_64"
	depends on BR2_x86_64
	depends on !BR2_TOOLCHAIN_USES_GLIBC
```

## buildroot-2024.02.9/configs/up7000_defconfig
```kconfig
# UP7000 Buildroot defconfig
# Target: Intel UP7000 (Alder Lake-N, x86_64), UEFI GRUB2, BusyBox init, GPT image
# Kernel: Linux 6.6.63 LTS
# Usage: make O=../output up7000_defconfig

# Architecture
BR2_x86_64=y

# Toolchain: glibc required by OpenVINO pre-built runtime binaries
BR2_TOOLCHAIN_BUILDROOT_GLIBC=y
BR2_TOOLCHAIN_BUILDROOT_CXX=y
# Kernel headers version must match (or be ≤) the kernel we build
BR2_KERNEL_HEADERS_6_6=y

# Parallel build: 0 = auto-detect nproc
BR2_JLEVEL=0

# ─── Linux Kernel ───────────────────────────────────────────────────────────
BR2_LINUX_KERNEL=y
BR2_LINUX_KERNEL_CUSTOM_VERSION=y
BR2_LINUX_KERNEL_CUSTOM_VERSION_VALUE="6.6.63"
# Use our kernel config fragment applied on top of x86_64_defconfig
BR2_LINUX_KERNEL_USE_CUSTOM_CONFIG=y
BR2_LINUX_KERNEL_CUSTOM_CONFIG_FILE="board/up7000/linux.config"
BR2_LINUX_KERNEL_BZIMAGE=y
BR2_LINUX_KERNEL_NEEDS_HOST_OPENSSL=y

# ─── Bootloader: GRUB2 EFI (64-bit) ────────────────────────────────────────
BR2_TARGET_GRUB2=y
BR2_TARGET_GRUB2_X86_64_EFI=y
BR2_TARGET_GRUB2_CFG_FILE="board/up7000/grub.cfg"
BR2_TARGET_GRUB2_BUILTIN_MODULES_EFI="boot linux ext2 fat part_msdos part_gpt normal serial terminal terminfo"

# ─── Root filesystem: ext4 ──────────────────────────────────────────────────
BR2_TARGET_ROOTFS_EXT2=y
BR2_TARGET_ROOTFS_EXT2_4=y
BR2_TARGET_ROOTFS_EXT2_LABEL="rootfs"
BR2_TARGET_ROOTFS_EXT2_SIZE="2048M"

# ─── Post-build and post-image hooks ────────────────────────────────────────
BR2_ROOTFS_POST_BUILD_SCRIPT="board/up7000/post-build.sh"
BR2_ROOTFS_POST_IMAGE_SCRIPT="board/up7000/post-image.sh"

# ─── Rootfs overlay (network config, etc.) ──────────────────────────────────
BR2_ROOTFS_OVERLAY="board/up7000/rootfs-overlay"

# ─── Init system: BusyBox (simple, proven to work on UP7000) ────────────────
BR2_INIT_BUSYBOX=y
BR2_ROOTFS_DEVICE_CREATION_DYNAMIC_EUDEV=y

# ─── System configuration ───────────────────────────────────────────────────
BR2_TARGET_GENERIC_HOSTNAME="up7000"
BR2_TARGET_GENERIC_ISSUE="Welcome to UP7000 Buildroot"
BR2_TARGET_GENERIC_ROOT_PASSWD="root"
BR2_TARGET_GENERIC_GETTY=y
BR2_TARGET_GENERIC_GETTY_PORT="ttyS0"
BR2_TARGET_GENERIC_GETTY_BAUDRATE_115200=y
BR2_TARGET_TZ_INFO=y
BR2_TARGET_LOCALTIME="UTC"

# ─── Network packages ───────────────────────────────────────────────────────
BR2_PACKAGE_LINUX_FIRMWARE=y
BR2_PACKAGE_LINUX_FIRMWARE_RTL_8169=y
BR2_PACKAGE_EUDEV=y
BR2_PACKAGE_IFUPDOWN_SCRIPTS=y
BR2_PACKAGE_OPENSSH=y
BR2_PACKAGE_IPROUTE2=y
BR2_PACKAGE_IPUTILS=y

# ─── Useful debug tools ─────────────────────────────────────────────────────
BR2_PACKAGE_HTOP=y
BR2_PACKAGE_NANO=y
BR2_PACKAGE_STRACE=y

# Host genimage tool (required by post-image.sh to create GPT disk image)
BR2_PACKAGE_HOST_GENIMAGE=y

# ─── BR2_EXTERNAL: UP7000 extras (OpenVINO, Intel GPU runtime, demo) ─────────
# Pass BR2_EXTERNAL="$(TOPDIR)/../br2-external" on the make command line;
# the path below is stored here only for reference.
# BR2_EXTERNAL="/path/to/br2-external"

# ─── OpenVINO & Intel GPU compute runtime ────────────────────────────────────
BR2_PACKAGE_TBB=y
BR2_PACKAGE_OPENCV4=y
BR2_PACKAGE_OPENCV4_LIB_IMGPROC=y
BR2_PACKAGE_OPENCV4_LIB_IMGCODECS=y
BR2_PACKAGE_OPENCV4_WITH_JPEG=y
BR2_PACKAGE_OPENCV4_WITH_PNG=y
BR2_PACKAGE_INTEL_GMMLIB=y
BR2_PACKAGE_LINUX_FIRMWARE_I915=y
BR2_PACKAGE_OPENVINO_RUNTIME=y
BR2_PACKAGE_INTEL_COMPUTE_RUNTIME=y
BR2_PACKAGE_INTEL_IPP=y
BR2_PACKAGE_OPENVINO_DEMO=y
BR2_PACKAGE_OPENVINO_BENCHMARK=y
```
